## config/west.yml
```yaml
manifest:
  defaults:
    revision: main

  remotes:
    - name: alexandregressier
      url-base: https://github.com/alexandregressier
    - name: urob
      url-base: https://github.com/urob

  projects:
    - name: zmk
      remote: alexandregressier
      revision: advantage360
      clone-depth: 0
      import: app/west.yml

    # ZMK modules
    - name: zmk-adaptive-key
      remote: alexandregressier
      path: modules/alexandregressier/zmk-adaptive-key
    - name: zmk-auto-layer
      remote: urob
      path: modules/urob/zmk-auto-layer
    - name: zmk-helpers
      remote: urob
      path: modules/urob/zmk-helpers
    - name: zmk-leader-key
      remote: urob
      path: modules/urob/zmk-leader-key
      revision: v0.1+locality # Set to same as ZMK version, check it in zmk/CHANGELOG.md. Locality = split keyboard support for &bootloader etc. +ignore-keys feature as well.
    - name: zmk-tri-state
      remote: urob
      path: modules/urob/zmk-tri-state

  self:
    path: config
```
