#include <behaviors.dtsi>
#include <behaviors/num_word.dtsi>
#include <dt-bindings/zmk/backlight.h>
#include <dt-bindings/zmk/bt.h>
#include <dt-bindings/zmk/keys.h>
#include <dt-bindings/zmk/rgb.h>

#define HOST_OS 2 // = macOS; Must be set before including helper.h
#include "zmk-helpers/helper.h"

#include "helper.h"
#include "secret.dtsi"
#include "symbols.dtsi"


/* Layers */

#define DEFAULT 0
#define NUMBERS 1
#define MOD 2


/* Timings */

#define QUICK_TAP_MS 175
#define DEFAULT_ADAPTIVE_TIMEOUT_MS 1000
#define SLOW_ADAPTIVE_TIMEOUT_MS 2000


/* Reconfigurations */

&sk { // Sticky Key
	release-after-ms = <900>; // Release after 0.9s
	quick-release;            // No double capitalization when rolling keys
	ignore-modifiers;         // (Default) Allows to combine sticky modifiers
};

&sl { // Sticky Layer
	release-after-ms = <5000>; // Default: 1000
	ignore-modifiers;          // Allow chording sticky mods & layers
};

&lt { // Layer-Tap
	flavor = "balanced";
	tapping-term-ms = <200>;
	quick-tap-ms = <QUICK_TAP_MS>;
};


/* Macros */

#define SIMPLE_MACRO(NAME, SEQUENCE) \
	ZMK_MACRO(NAME, \
		wait-ms = <0>; \
		tap-ms = <0>; \
		bindings = <SEQUENCE>; \
	)

ZMK_MACRO_ONE_PARAM(kp_reset,
	wait-ms = <0>;
	tap-ms = <0>;
	bindings
	= <&macro_param_1to1>
	, <&kp MACRO_PLACEHOLDER &to DEFAULT>;
)

/* Morphs */

#define SIMPLE_MORPH(NAME, MOD, BINDING1, BINDING2) \
    ZMK_MOD_MORPH(NAME, \
        mods = <(MOD_L ## MOD|MOD_R ## MOD)>; \
        bindings = <BINDING1>, <BINDING2>; \
    )

#define TAP_PREFERRED_HOLD_TAP(...) CONCAT(TAP_PREFERRED_HOLD_TAP_, VARGS(__VA_ARGS__))(__VA_ARGS__)
#define TAP_PREFERRED_HOLD_TAP_3(NAME, HOLD, TAP) \
    TAP_PREFERRED_HOLD_TAP_4(NAME, HOLD, TAP, 180)
#define TAP_PREFERRED_HOLD_TAP_4(NAME, HOLD, TAP, TERM) \
    TAP_PREFERRED_HOLD_TAP_5(NAME, HOLD, TAP, TERM, 200)
#define TAP_PREFERRED_HOLD_TAP_5(NAME, HOLD, TAP, TERM, IDLE) \
    ZMK_HOLD_TAP(NAME, \
		flavor = "tap-preferred"; \
		tapping-term-ms = <TERM>; \
		quick-tap-ms = <0>; \
		require-prior-idle-ms = <IDLE>; \
		bindings = <HOLD>, <TAP>; \
 	)

TAP_PREFERRED_HOLD_TAP(ht_kp_kp, &kp, &kp)
TAP_PREFERRED_HOLD_TAP(sht_kp_kp, &kp, &kp, 280, 200) // s = slow
TAP_PREFERRED_HOLD_TAP(ht_mo_kp, &mo, &kp)

#define BALANCED_HOLD_TAP(NAME, HOLD, TAP, TRIGGER_POS) \
    ZMK_HOLD_TAP(NAME, \
		flavor = "balanced"; \
		tapping-term-ms = <180>; \
		quick-tap-ms = <0>; \
		require-prior-idle-ms = <200>; \
		bindings = <HOLD>, <TAP>; \
		hold-trigger-key-positions = <TRIGGER_POS>; \
        hold-trigger-on-release; \
 	)

ZMK_AUTO_LAYER(number_word,
	continue-list = <BACKSPACE DELETE DOT COMMA>;
	ignore-numbers;
)

ZMK_ADAPTIVE_KEY(ht_num_backspace,
	bindings = <&bht_numword_kp NUMBERS BACKSPACE>;
	backspace {
		trigger-keys = <BACKSPACE>;
		max-prior-idle-ms = <500>;
		bindings = <&kp BACKSPACE>;
	};
)
BALANCED_HOLD_TAP(bht_numword_kp, &number_word, &kp, NUMPAD)


KP_WITH_MOD_SEQUENCE(rgkp, RGUI)
KP_WITH_MOD_SEQUENCE(rakp, RALT)
KP_WITH_MOD_SEQUENCE(rckp, RCTL)

TAP_PREFERRED_HOLD_TAP(ht_rgkp_kp, &rgkp, &kp)
TAP_PREFERRED_HOLD_TAP(sht_rgkp_kp, &rgkp, &kp, 280, 200) // s = Slow
TAP_PREFERRED_HOLD_TAP(ht_kp_rgkp, &kp, &rgkp)
TAP_PREFERRED_HOLD_TAP(ht_rgkp_rgkp, &rgkp, &rgkp)

TAP_PREFERRED_HOLD_TAP(ht_kp_rakp, &kp, &rakp)

TAP_PREFERRED_HOLD_TAP(ht_kp_rckp, &kp, &rckp)


/* Homerow Mods */

#define MAKE_HRM(NAME, HOLD, TAP, TRIGGER_POS) \
    ZMK_HOLD_TAP(NAME, \
        flavor = "balanced"; \
        tapping-term-ms = <180>; \
        quick-tap-ms = <QUICK_TAP_MS>; \
        require-prior-idle-ms = <200>; \
        bindings = <HOLD>, <TAP>; \
        hold-trigger-key-positions = <TRIGGER_POS>; \
        hold-trigger-on-release; \
    )
MAKE_HRM(hml, &kp, &kp, KEYS_RIGHT THUMBS_LEFT THUMBS_RIGHT) // Left-hand HRMs
MAKE_HRM(hmr, &kp, &kp, KEYS_LEFT THUMBS_LEFT THUMBS_RIGHT) // Right-hand HRMs


/* Combos */

#include "combos.dtsi"

/* Symbols */

SIMPLE_MACRO(m_curly_single_quote_pair, &u_left_curly_single_quote &u_curly_apostrophe &kp LEFT)

SIMPLE_MORPH(u_single_quote_morph, SFT, &u_curly_apostrophe, &m_curly_single_quote_pair)

//SIMPLE_MACRO(m_curly_double_quotes_pair, &u_left_curly_double_quotes &u_right_curly_double_quotes &kp LEFT)
SIMPLE_MACRO(m_guillemet_pair, &u_guillemet_left &kp SPACE &kp SPACE &u_guillemet_right &kp LEFT &kp LEFT)

//SIMPLE_MORPH(u_double_quotes_morph, SFT, &m_curly_double_quotes_pair, &m_guillemet_pair)

SIMPLE_MACRO(m_fr_ou, &kp O &fr_u_grave)


/* Number Row */

// 1
MAKE_NUMBER_ROW_KEY(N5, n5, CARET, caret, TILDE, tilde,
	tilde { trigger-keys = <TILDE>; bindings = <&kp TILDE>; max-prior-idle-ms = <DEFAULT_ADAPTIVE_TIMEOUT_MS>; allow-more-modifiers; };
)
// 2
MAKE_NUMBER_ROW_KEY(N3, n3, LEFT_BRACKET, left_bracket, ASTERISK, ASTERISK,
	hash { trigger-keys = <ASTERISK>; bindings = <&key_repeat>; max-prior-idle-ms = <DEFAULT_ADAPTIVE_TIMEOUT_MS>; allow-more-modifiers; };
)
// 3
MAKE_NUMBER_ROW_KEY(N1, n1, LEFT_BRACE, left_brace, RIGHT_BRACKET, right_bracket,
	right_bracket { trigger-keys = <LEFT_BRACKET RIGHT_BRACKET>; bindings = <&kp RIGHT_BRACKET>; max-prior-idle-ms = <DEFAULT_ADAPTIVE_TIMEOUT_MS>; allow-more-modifiers; };
)
// 4
MAKE_NUMBER_ROW_KEY(N2, n2, QUESTION, question, RIGHT_BRACE, right_brace,
	right_brace { trigger-keys = <LEFT_BRACE RIGHT_BRACE>; bindings = <&kp RIGHT_BRACE>; max-prior-idle-ms = <DEFAULT_ADAPTIVE_TIMEOUT_MS>; allow-more-modifiers; };
)
// 5
MAKE_NUMBER_ROW_KEY(N4, n4, EXCLAMATION, exclamation, HASH, hash,
	star { trigger-keys = <HASH>; bindings = <&kp HASH>; max-prior-idle-ms = <DEFAULT_ADAPTIVE_TIMEOUT_MS>; allow-more-modifiers; };
)


// 6
MAKE_NUMBER_ROW_KEY(N7, n7, UNDERSCORE, underscore, AMPERSAND, ampersand,
	ampersand { trigger-keys = <AMPERSAND>; bindings = <&kp AMPERSAND>; max-prior-idle-ms = <DEFAULT_ADAPTIVE_TIMEOUT_MS>; strict-modifiers; };
)
// 7
MAKE_NUMBER_ROW_KEY(N9, n9, MINUS, minus, LESS_THAN, less_than,
	less_than { trigger-keys = <LESS_THAN GREATER_THAN>; bindings = <&kp LESS_THAN>; max-prior-idle-ms = <DEFAULT_ADAPTIVE_TIMEOUT_MS>; strict-modifiers; };
)
// 8
MAKE_NUMBER_ROW_KEY(N0, n0, LEFT_PARENTHESIS, left_parenthesis, GREATER_THAN, greater_than,
	greater_than { trigger-keys = <LESS_THAN GREATER_THAN MINUS EQUAL>; bindings = <&kp GREATER_THAN>; max-prior-idle-ms = <DEFAULT_ADAPTIVE_TIMEOUT_MS>; strict-modifiers; };
)
// 9
MAKE_NUMBER_ROW_KEY(N8, n8, EQUAL, equal, RIGHT_PARENTHESIS, right_parenthesis,
	right_parenthesis { trigger-keys = <LEFT_PARENTHESIS RIGHT_PARENTHESIS>; bindings = <&kp RIGHT_PARENTHESIS>; max-prior-idle-ms = <DEFAULT_ADAPTIVE_TIMEOUT_MS>; strict-modifiers; };
)
// 0
MAKE_NUMBER_ROW_KEY(N6, n6, PLUS, plus, PIPE, pipe,
	pipe { trigger-keys = <PIPE>; bindings = <&kp PIPE>; max-prior-idle-ms = <DEFAULT_ADAPTIVE_TIMEOUT_MS>; strict-modifiers; };
)

// Secret
ZMK_MOD_MORPH(secret_morph,
	bindings = <&m_secret_return>, <&m_secret>;
	mods = <(MOD_RSFT)>;
)


/* Top Row */

// Grave
ZMK_ADAPTIVE_KEY(ag_grave,
	bindings = <&grave_morph>;
)
ZMK_MOD_MORPH(grave_morph,
	bindings = <&ht_rgkp_kp GRAVE GRAVE>, <&ht_rgkp_mtriplebackticks RS(GRAVE) 0>;
	mods = <(MOD_RSFT)>;
)
TAP_PREFERRED_HOLD_TAP(ht_rgkp_mtriplebackticks, &rgkp, &m_triple_backticks)
SIMPLE_MACRO(m_triple_backticks, &kp GRAVE &kp GRAVE &kp GRAVE)

// Q
MAKE_LETTER_KEY(Q, q, sht_rgkp_kp, // Slow because misfires
	rg_q { trigger-keys = <RG(Q)>; bindings = <&key_repeat>; max-prior-idle-ms = <DEFAULT_ADAPTIVE_TIMEOUT_MS>; strict-modifiers; };
)
// W
MAKE_LETTER_KEY(W, w, ht_rgkp_kp,
	rg_w { trigger-keys = <RG(W)>; bindings = <&key_repeat>; max-prior-idle-ms = <DEFAULT_ADAPTIVE_TIMEOUT_MS>; strict-modifiers; };
)
// E
MAKE_LETTER_KEY(E, e)
// R
MAKE_LETTER_KEY(R, r)
// T
MAKE_LETTER_KEY(T, t, sht_rgkp_kp)


// Y
MAKE_LETTER_KEY(Y, y, sht_rgkp_kp) // Slow because misfires
// U
MAKE_LETTER_KEY(U, u)
// I
MAKE_LETTER_KEY(I, i)
// O
MAKE_LETTER_KEY(O, o)
// P
MAKE_LETTER_KEY(P, p, sht_rgkp_kp) // Slow because misfires

// Backslash
ZMK_ADAPTIVE_KEY(ag_backslash,
	bindings = <&backslash_morph>;
)
ZMK_MOD_MORPH(backslash_morph,
	bindings = <&ht_rgkp_kp BACKSLASH BACKSLASH>, <&ht_rgkp_ueuro RS(BACKSLASH) 0>;
	mods = <(MOD_RSFT)>;
)
TAP_PREFERRED_HOLD_TAP(ht_rgkp_ueuro, &rgkp, &u_euro)


/* Middle Row */

// Double quotes
ZMK_ADAPTIVE_KEY(ag_double_quotes,
	bindings = <&double_quotes_morph>;
)
ZMK_MOD_MORPH(double_quotes_morph,
	bindings = <&ht_rgkp_kp DOUBLE_QUOTES DOUBLE_QUOTES>, <&ht_rgkp_mcurlydoublequotespair RS(DOUBLE_QUOTES) 0>;
	mods = <(MOD_RSFT)>;
)
TAP_PREFERRED_HOLD_TAP(ht_rgkp_mcurlydoublequotespair, &rgkp, &u_left_curly_double_quotes)
//SIMPLE_MACRO(m_curly_double_quotes_pair, &u_left_curly_double_quotes &u_right_curly_double_quotes &kp LEFT)

// A
MAKE_LETTER_KEY(A, a)
// S
MAKE_LETTER_KEY(S, s)
// D
MAKE_LETTER_KEY(D, d)
// F
MAKE_LETTER_KEY(F, f)
// G
MAKE_LETTER_KEY(G, g)


// H
MAKE_LETTER_KEY(H, h, ht_rgkp_kp,
	rg_h { trigger-keys = <RG(H)>; bindings = <&key_repeat>; max-prior-idle-ms = <DEFAULT_ADAPTIVE_TIMEOUT_MS>; strict-modifiers; };
)
// J
MAKE_LETTER_KEY(J, j)
// K
MAKE_LETTER_KEY(K, k)
// L
MAKE_LETTER_KEY(L, l)
// Colon
MAKE_SPECIAL_CHAR_KEY(COLON, colon, PLUS, plus)

// Single quote
ZMK_ADAPTIVE_KEY(ag_single_quote,
	bindings = <&single_quote_morph>;
)
ZMK_MOD_MORPH(single_quote_morph,
	bindings = <&ht_rgkp_kp SINGLE_QUOTE SINGLE_QUOTE>, <&ht_rgkp_ucurlyapostrophe RS(SINGLE_QUOTE) 0>;
	mods = <(MOD_RSFT)>;
)
TAP_PREFERRED_HOLD_TAP(ht_rgkp_ucurlyapostrophe, &rgkp, &u_curly_apostrophe)


/* Bottom Row */

// Z
MAKE_LETTER_KEY(Z, z) // No smart repeat because this isn't used as undo/redo

// X
MAKE_LETTER_KEY(X, x, ht_rgkp_kp,
	rg_x { trigger-keys = <RG(A) RG(X) RG(C) RG(V) LG(A) LG(X) LG(C) LG(V)>; bindings = <&ht_rgkp_kp X RG(X)>; max-prior-idle-ms = <DEFAULT_ADAPTIVE_TIMEOUT_MS>; allow-more-modifiers; };
)
// C
MAKE_LETTER_KEY(C, c, ht_rgkp_kp,
	rg_c { trigger-keys = <RG(A) RG(X) RG(C) RG(V) LG(A) LG(X) LG(C) LG(V)>; bindings = <&ht_rgkp_kp C RG(C)>; max-prior-idle-ms = <DEFAULT_ADAPTIVE_TIMEOUT_MS>; allow-more-modifiers; };
)
// V
MAKE_LETTER_KEY(V, v, ht_rgkp_kp,
	rg_v { trigger-keys = <RG(A) RG(X) RG(C) RG(V) LG(A) LG(X) LG(C) LG(V)>; bindings = <&ht_rgkp_kp V RG(V)>; max-prior-idle-ms = <DEFAULT_ADAPTIVE_TIMEOUT_MS>; allow-more-modifiers; };
)
// B
MAKE_LETTER_KEY(B, b)


// N
MAKE_LETTER_KEY(N, n)
// M
MAKE_LETTER_KEY(M, m)
// Comma
MAKE_SPECIAL_CHAR_KEY(COMMA, comma, SEMICOLON, semicolon)
// Dot
MAKE_SPECIAL_CHAR_KEY(DOT, dot, AT_SIGN, at_sign)
// Slash
MAKE_SPECIAL_CHAR_KEY(SLASH, slash, PERCENT, percent)


/* Mods Row */

#define PRESERVE_ADAPTIVE_MODIFIERS_MS 500

#define PRESERVE_ADAPTIVE_MODIFIERS(KEY, TRIGGER_KEY, TRIGGER_KEY_LOWER) \
	ls_ ## TRIGGER_KEY_LOWER { trigger-keys = <LS(TRIGGER_KEY)>; max-prior-idle-ms = <PRESERVE_ADAPTIVE_MODIFIERS_MS>; bindings = <&kp LS(KEY)>; strict-modifiers; }; \
	lg_ ## TRIGGER_KEY_LOWER { trigger-keys = <LG(TRIGGER_KEY)>; max-prior-idle-ms = <PRESERVE_ADAPTIVE_MODIFIERS_MS>; bindings = <&kp LG(KEY)>; strict-modifiers; }; \
	la_ ## TRIGGER_KEY_LOWER { trigger-keys = <LA(TRIGGER_KEY)>; max-prior-idle-ms = <PRESERVE_ADAPTIVE_MODIFIERS_MS>; bindings = <&kp LA(KEY)>; strict-modifiers; }; \
	lc_ ## TRIGGER_KEY_LOWER { trigger-keys = <LC(TRIGGER_KEY)>; max-prior-idle-ms = <PRESERVE_ADAPTIVE_MODIFIERS_MS>; bindings = <&kp LC(KEY)>; strict-modifiers; }; \
	ls_lg_ ## TRIGGER_KEY_LOWER { trigger-keys = <LS(LG(TRIGGER_KEY))>; max-prior-idle-ms = <PRESERVE_ADAPTIVE_MODIFIERS_MS>; bindings = <&kp LS(LG(KEY))>; strict-modifiers; }; \
	ls_la_ ## TRIGGER_KEY_LOWER { trigger-keys = <LS(LA(TRIGGER_KEY))>; max-prior-idle-ms = <PRESERVE_ADAPTIVE_MODIFIERS_MS>; bindings = <&kp LS(LA(KEY))>; strict-modifiers; }; \
	ls_lc_ ## TRIGGER_KEY_LOWER { trigger-keys = <LS(LC(TRIGGER_KEY))>; max-prior-idle-ms = <PRESERVE_ADAPTIVE_MODIFIERS_MS>; bindings = <&kp LS(LC(KEY))>; strict-modifiers; }; \
	lg_la_ ## TRIGGER_KEY_LOWER { trigger-keys = <LG(LA(TRIGGER_KEY))>; max-prior-idle-ms = <PRESERVE_ADAPTIVE_MODIFIERS_MS>; bindings = <&kp LG(LA(KEY))>; strict-modifiers; }; \
	lg_lc_ ## TRIGGER_KEY_LOWER { trigger-keys = <LG(LC(TRIGGER_KEY))>; max-prior-idle-ms = <PRESERVE_ADAPTIVE_MODIFIERS_MS>; bindings = <&kp LG(LC(KEY))>; strict-modifiers; }; \
	la_lc_ ## TRIGGER_KEY_LOWER { trigger-keys = <LA(LC(TRIGGER_KEY))>; max-prior-idle-ms = <PRESERVE_ADAPTIVE_MODIFIERS_MS>; bindings = <&kp LA(LC(KEY))>; strict-modifiers; }; \
	ls_lg_la_ ## TRIGGER_KEY_LOWER { trigger-keys = <LS(LG(LA(TRIGGER_KEY)))>; max-prior-idle-ms = <PRESERVE_ADAPTIVE_MODIFIERS_MS>; bindings = <&kp LS(LG(LA(KEY)))>; strict-modifiers; }; \
	ls_lg_lc_ ## TRIGGER_KEY_LOWER { trigger-keys = <LS(LG(LC(TRIGGER_KEY)))>; max-prior-idle-ms = <PRESERVE_ADAPTIVE_MODIFIERS_MS>; bindings = <&kp LS(LG(LC(KEY)))>; strict-modifiers; }; \
	ls_la_lc_ ## TRIGGER_KEY_LOWER { trigger-keys = <LS(LA(LC(TRIGGER_KEY)))>; max-prior-idle-ms = <PRESERVE_ADAPTIVE_MODIFIERS_MS>; bindings = <&kp LS(LA(LC(KEY)))>; strict-modifiers; }; \
	lg_la_lc_ ## TRIGGER_KEY_LOWER { trigger-keys = <LG(LA(LC(TRIGGER_KEY)))>; max-prior-idle-ms = <PRESERVE_ADAPTIVE_MODIFIERS_MS>; bindings = <&kp LG(LA(LC(KEY)))>; strict-modifiers; }; \
	ls_lg_la_lc_ ## TRIGGER_KEY_LOWER { trigger-keys = <LS(LG(LA(LC(TRIGGER_KEY))))>; max-prior-idle-ms = <PRESERVE_ADAPTIVE_MODIFIERS_MS>; bindings = <&kp LS(LG(LA(LC(KEY))))>; strict-modifiers; };

// Left
ZMK_ADAPTIVE_KEY(ag_left,
	bindings = <&hml LCTRL LEFT>;
	PRESERVE_ADAPTIVE_MODIFIERS(LEFT, LEFT, left)
	PRESERVE_ADAPTIVE_MODIFIERS(LEFT, RIGHT, right)
	PRESERVE_ADAPTIVE_MODIFIERS(LEFT, DOWN, down)
	PRESERVE_ADAPTIVE_MODIFIERS(LEFT, UP, up)
)
// Right
ZMK_ADAPTIVE_KEY(ag_right,
	bindings = <&hmr LALT RIGHT>;
	PRESERVE_ADAPTIVE_MODIFIERS(RIGHT, LEFT, left)
	PRESERVE_ADAPTIVE_MODIFIERS(RIGHT, RIGHT, right)
	PRESERVE_ADAPTIVE_MODIFIERS(RIGHT, DOWN, down)
	PRESERVE_ADAPTIVE_MODIFIERS(RIGHT, UP, up)
)


// Tab
ZMK_ADAPTIVE_KEY(ag_tab,
	bindings = <&hml LGUI TAB>;
	PRESERVE_ADAPTIVE_MODIFIERS(TAB, TAB, tab)
)

// Down
ZMK_ADAPTIVE_KEY(ag_down,
	bindings = <&hmr LGUI DOWN>;
	PRESERVE_ADAPTIVE_MODIFIERS(DOWN, LEFT, left)
	PRESERVE_ADAPTIVE_MODIFIERS(DOWN, RIGHT, right)
	PRESERVE_ADAPTIVE_MODIFIERS(DOWN, DOWN, down)
	PRESERVE_ADAPTIVE_MODIFIERS(DOWN, UP, up)
)
// Up
ZMK_ADAPTIVE_KEY(ag_up,
	bindings = <&hmr LALT UP>;
	PRESERVE_ADAPTIVE_MODIFIERS(UP, LEFT, left)
	PRESERVE_ADAPTIVE_MODIFIERS(UP, RIGHT, right)
	PRESERVE_ADAPTIVE_MODIFIERS(UP, DOWN, down)
	PRESERVE_ADAPTIVE_MODIFIERS(UP, UP, up)
)
// Shift + Tab
ZMK_ADAPTIVE_KEY(ag_lstab,
	bindings = <&hml LCTRL LS(TAB)>;
)


/* Numpad */ // Numpad instead of keypad because it abbreviates kp as well

// aq = adaptive quit
#define MAKE_NUMPAD_KEY(NUMBER, BEHIND_KEY) \
	ZMK_ADAPTIVE_KEY(aq_np ## NUMBER ##, \
		bindings = <&np ## NUMBER ## _morph>; \
	) \
	ZMK_MOD_MORPH(np ## NUMBER ## _morph, \
		bindings = <&ht_kp_kp BEHIND_KEY N ## NUMBER>, <&ht_kp_kp BEHIND_KEY N ## NUMBER>; \
		mods = <(MOD_RSFT)>; \
	)

MAKE_NUMPAD_KEY(1, M)
MAKE_NUMPAD_KEY(2, COMMA)
MAKE_NUMPAD_KEY(3, DOT)
MAKE_NUMPAD_KEY(4, J)
MAKE_NUMPAD_KEY(5, K)
MAKE_NUMPAD_KEY(6, L)
MAKE_NUMPAD_KEY(7, U)
MAKE_NUMPAD_KEY(8, I)
MAKE_NUMPAD_KEY(9, O)


/* Smart Shift */

#define MAKE_SMART_SHIFT(NAME, SHIFT_KEY) \
	ZMK_ADAPTIVE_KEY(NAME, \
		bindings = <&ht_kp_ ## SHIFT_KEY ## _dance SHIFT_KEY SHIFT_KEY>; \
	) \
	ZMK_HOLD_TAP(ht_kp_ ## SHIFT_KEY ## _dance, \
		flavor = "balanced"; \
		tapping-term-ms = <200>; \
		quick-tap-ms = <QUICK_TAP_MS>; \
		bindings = <&kp>, <&sk>; \
	)

MAKE_SMART_SHIFT(smart_lshift, LEFT_SHIFT)
MAKE_SMART_SHIFT(smart_rshift, RIGHT_SHIFT)

&caps_word {
	/delete-property/ ignore-modifiers;
};


/* Smart Number */


//ZMK_HOLD_TAP(smart_num,
//	flavor = "balanced";
//	tapping-term-ms = <200>;
//	quick-tap-ms = <QUICK_TAP_MS>;
//	bindings = <&mo>, <&num_dance>;
//)
//ZMK_TAP_DANCE(num_dance,
//	tapping-term-ms = <400>;
//	bindings = <&num_word NUMBERS>, <&tog NUMBERS>;
//)

//&num_word {
//	ignore-modifiers; // Needed for shortcuts like
//};
